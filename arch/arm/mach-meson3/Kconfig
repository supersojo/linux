## arch/arm/mach-meson3/Kconfig
```kconfig
# SPDX-License-Identifier: GPL-2.0-only
menuconfig ARCH_MESON3
	bool "Amlogic Meson 8726M3 SoCs"
	depends on ARCH_MULTI_V7
	select GPIOLIB
	select GENERIC_IRQ_CHIP
	select ARM_GLOBAL_TIMER
	select CACHE_L2X0
	select HAVE_ARM_SCU if SMP
	select HAVE_ARM_TWD if SMP

if ARCH_MESON3

# more custom maybe defined here
config MACH_MESON3
	bool "Amlogic Meson3 (88726M3) Socs support"
	default ARCH_MESON3
endif
```

## drivers/clk/meson3/Kconfig
```kconfig
# SPDX-License-Identifier: GPL-2.0-only
menu "Clock support for Amlogic platforms(8726m3)"
	depends on ARCH_MESON3 || COMPILE_TEST

config COMMON_CLK_MESON_REGMAP
	tristate
	select REGMAP

config COMMON_CLK_MESON_CLOCK_MEASURE
	tristate
	select COMMON_CLK_MESON_REGMAP


config COMMON_CLK_MESON3
    bool "Meson3 SoC Clock controller support"
    depends on ARM
    default y
	select COMMON_CLK_MESON_CLOCK_MEASURE
	select MFD_SYSCON
	select RESET_CONTROLLER
	help
	  Support for the clock controller on AmLogic 8726m3 (Meson3),

endmenu
```
